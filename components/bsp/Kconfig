## components/bsp/Kconfig
```kconfig
menu "BSP configuration"

    menu "LCD configuration"
        config BSP_LCD_PIN_RST
            int "LCD RST Pin Number"
            default 1
            range 0 10

        config BSP_LCD_PIN_MOSI
            int "LCD MOSI Pin Number"
            default 2
            range 0 10

        config BSP_LCD_PIN_CLK
            int "LCD CLK Pin Number"
            default 5
            range 0 10

        config BSP_LCD_PIN_CS
            int "LCD CS Pin Number"
            default 6
            range 0 10

        config BSP_LCD_PIN_DC
            int "LCD D/C Pin Number"
            default 7
            range 0 10

        config BSP_LCD_PIN_BL
            int "LCD BackLight Pin Number"
            default 10
            range 0 10

        config BSP_LCD_SPI_CLOCK_MHZ
            int "LCD SPI Clock(MHz)"
            default 40
            range 20 80
    endmenu

endmenu
```

## main/Kconfig
```kconfig
menu "Application configuration"

    config APP_WIFI_SSID
        string "WiFi SSID"
        default "myssid"
        help
            SSID (network name) for the example to connect to.

    config APP_WIFI_PASSWORD
        string "WiFi Password"
        default "mypassword"
        help
            WiFi password (WPA or WPA2) for the example to use.
    
    config APP_QWEATHER_KEY
        string "QWeather Key"
        default ""
        help
            QWeather applicatoon key for access online weather info.
            
    config APP_QWEATHER_DISTRICT
        string "QWeather District Name"
        default "huangdao"
        help
            Your district name for QWeather to lookup the weather.

    config APP_QWEATHER_ADM
        string "QWeather City Name"
        default "qingdao"
        help
            Your city name for QWeather to lookup the weather.

endmenu
```

## sdkconfig.defaults
```kconfig
CONFIG_ESPTOOLPY_FLASHSIZE_4MB=y
CONFIG_PARTITION_TABLE_CUSTOM=y
CONFIG_COMPILER_OPTIMIZATION_PERF=y
CONFIG_ESP_SYSTEM_PANIC_PRINT_HALT=y
CONFIG_NEWLIB_NANO_FORMAT=y
CONFIG_LV_COLOR_16_SWAP=y
CONFIG_LV_MEM_CUSTOM=y
CONFIG_LV_DISP_DEF_REFR_PERIOD=20
CONFIG_LV_INDEV_DEF_READ_PERIOD=50
CONFIG_LV_USE_LOG=y
CONFIG_LV_LOG_PRINTF=y
CONFIG_LV_FONT_FMT_TXT_LARGE=y
CONFIG_LV_USE_FONT_COMPRESSED=y
```
